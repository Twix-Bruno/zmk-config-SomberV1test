## config/boards/shields/Kconfig.defconfig
```kconfig
if SHIELD_SomberV1test

config ZMK_KEYBOARD_NAME
    default "SomberV1test"

endif
```

## config/boards/shields/Kconfig.shield
```kconfig
config SHIELD_SomberV1test
    def_bool $(shields_list_containers, SomberV1test)
```
